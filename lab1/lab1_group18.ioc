# file: lab1_group18.ioc
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Mcu.Family=STM32L4
Mcu.Name=STM32L4S5VITx
Mcu.Package=LQFP100
NVIC.PriorityGroup=NVIC_PRIORITYGROUP_4
PA13\ (JTMS/SWDIO).Mode=Trace_Asynchronous_SW
PA13\ (JTMS/SWDIO).Signal=SYS_JTMS-SWDIO
PA14\ (JTCK/SWCLK).Mode=Trace_Asynchronous_SW
PA14\ (JTCK/SWCLK).Signal=SYS_JTCK-SWCLK
PB3\ (JTDO/TRACESWO).Mode=Trace_Asynchronous_SW
PB3\ (JTDO/TRACESWO).Signal=SYS_JTDO-SWO
ProjectManager.HeapSize=0x200
ProjectManager.StackSize=0x400
ProjectManager.TargetToolchain=STM32CubeIDE
RCC.ADCFreq_Value=48000000
RCC.AHBFreq_Value=120000000
RCC.APB1Freq_Value=120000000
RCC.APB1TimFreq_Value=120000000
RCC.APB2Freq_Value=120000000
RCC.APB2TimFreq_Value=120000000
RCC.CortexFreq_Value=120000000
RCC.HCLKFreq_Value=120000000
RCC.HSE_VALUE=8000000
RCC.HSI48_VALUE=48000000
RCC.HSI_VALUE=16000000
RCC.LSE_VALUE=32768
RCC.MSI_VALUE=4000000
RCC.PLLN=60
RCC.PLLSAI1N=24
RCC.SYSCLKFreq_VALUE=120000000
RCC.SYSCLKSource=RCC_SYSCLKSOURCE_PLLCLK
RCC.USBFreq_Value=48000000
RCC.VCOOutputFreq_Value=240000000
board=B-L4S5I-IOT01A

// file: Src/main.c
/* USER CODE BEGIN Header */
/**
  ******************************************************************************
  * @file           : main.c
  * @brief          : Main program body
  ******************************************************************************
  * @attention
  *
  * Copyright (c) 2022 STMicroelectronics.
  * All rights reserved.
  *
  * This software is licensed under terms that can be found in the LICENSE file
  * in the root directory of this software component.
  * If no LICENSE file comes with this software, it is provided AS-IS.
  *
  ******************************************************************************
  */
/* USER CODE END Header */
#include "main.h"

/* USER CODE BEGIN PD */
#define ITM_Port32(n) (*((volatile unsigned long *) (0xE0000000+4*n)))
/* USER CODE END PD */

void SystemClock_Config(void);
static void MX_GPIO_Init(void);

int main(void)
{

  /* MCU Configuration--------------------------------------------------------*/

  /* Reset of all peripherals, Initializes the Flash interface and the Systick. */
  HAL_Init();

  /* Configure the system clock */
  SystemClock_Config();

  /* Initialize all configured peripherals */
  MX_GPIO_Init();
  /* USER CODE BEGIN 2 */

  // part 1 demo
  struct kalman_state testState = {0.1, 0.1, 5.0, 0.1, 0};
  float output[5];
  for (int i=0; i<5; i++) {
	  output[i] = kalman(&testState, (float)i);	// execute kalman filter with testState and i as measurement input
  }
  // output should now contain 1.67, 1.25, 1.71, 2.5, 3.43

  // part 2 - code profiling
  const float test_array[] = {10.4915760032, 10.1349974709, 9.53992591829, 9.60311878706, 10.4858891793, 10.1104642352, 9.51066931906, 9.75755656493, 9.82154078273, 10.2906541933, 10.4861328671, 9.57321181356, 9.70882714139, 10.4359069357, 9.70644021369, 10.2709894039, 10.0823149505, 10.2954563443, 9.57130449017, 9.66832136479, 10.4521677502, 10.4287240667, 10.1833650752, 10.0066049721, 10.3279461634, 10.4767210803, 10.3790964606, 10.1937408814, 10.0318963522, 10.4939180917, 10.2381858895, 9.59703103024, 9.62757986516, 10.1816981174, 9.65703773168, 10.3905666599, 10.0941977598, 9.93515274393, 9.71017053437, 10.0303874259, 10.0173504397, 9.69022731474, 9.73902896102, 9.52524419732, 10.3270730526, 9.54695650657, 10.3573960542, 9.88773266876, 10.1685038683, 10.1683694089, 9.88406620159, 10.3290065898, 10.2547227265, 10.4733422906, 10.0133952458, 10.4205693583, 9.71335255372, 9.89061396699, 10.1652744131, 10.2580948608, 10.3465431058, 9.98446410493, 9.79376005657, 10.202518901, 9.83867150985, 9.89532986869, 10.2885062658, 9.97748768804, 10.0403923759, 10.1538911808, 9.78303667556, 9.72420149909, 9.59117495073, 10.1716116012, 10.2015818969, 9.90650056596, 10.3251329834, 10.4550120431, 10.4925749165, 10.1548177178, 9.60547133785, 10.4644672766, 10.2326496615, 10.2279703226, 10.3535284606, 10.2437410625, 10.3851531317, 9.90784804928, 9.98208344925, 9.52778805729, 9.69323876912, 9.92987312087, 9.73938925207, 9.60543743477, 9.79600805462, 10.4950988486, 10.2814361401, 9.7985283333, 9.6287888922, 10.4491538991, 9.5799256668};	// provided values
  const int array_len = 101;

  float asm_output[array_len];
  float c_output[array_len];
  float cmsis_output[array_len];

  // results
  float c_sub_results[array_len];
  float c_mean = 0;
  float c_sd = 0;
  float c_corr_results[2*array_len-1];
  float c_conv_results[2*array_len-1];

  float32_t cmsis_sub_results[array_len];
  float32_t cmsis_mean;
  float32_t cmsis_sd;
  float32_t cmsis_corr_results[2*array_len-1];
  float32_t cmsis_conv_results[2*array_len-1];

  struct kalman_state state_asm = {0.1, 0.5, 10.0, 0.1, 0};
  struct kalman_state state_c = {0.1, 0.5, 10.0, 0.1, 0};
  struct kalman_state state_cmsis = {0.1, 0.5, 10.0, 0.1, 0};

  // get result array for both asm and c functions
  ITM_Port32(31) = 1;	// 1: Asm Kalman Filter
  Kalmanfilter(test_array, asm_output, &state_asm, array_len);
  ITM_Port32(31) = 2;	// 2: C Kalman filter
  Kalmanfilter_c(test_array, c_output, &state_c, array_len);
  ITM_Port32(31) = 14;
  Kalmanfilter_cmsis(test_array, cmsis_output, &state_cmsis, array_len);

  // plain c function test
  ITM_Port32(31) = 3;	// 3: c difference
  vec_sub(test_array, asm_output, c_sub_results, array_len);
  ITM_Port32(31) = 4;	// 4: c mean
  c_mean = vec_mean(c_sub_results, array_len);
  ITM_Port32(31) = 5;	// 5: c standard deviation
  c_sd = vec_sd(c_sub_results, array_len);
  ITM_Port32(31) = 6;	// 6: c correlation
  vec_correlation(test_array, asm_output, c_corr_results, array_len);
  ITM_Port32(31) = 7;	// 7: c convolution
  vec_convolution(test_array, asm_output, c_conv_results, array_len);

  // cmsis function test
  ITM_Port32(31) = 8;	// 8: cmsis difference
  arm_sub_f32(test_array, asm_output, cmsis_sub_results, (uint32_t)array_len);
  ITM_Port32(31) = 9;	// 9: cmsis mean
  arm_mean_f32(cmsis_sub_results, (uint32_t)array_len, &cmsis_mean);
  ITM_Port32(31) = 10;	// 10: cmsis standard deviation
  arm_std_f32(cmsis_sub_results, (uint32_t)array_len, &cmsis_sd);
  ITM_Port32(31) = 11;	// 11: cmsis correlation
  arm_correlate_f32(test_array, (uint32_t)array_len, asm_output, (uint32_t)array_len, cmsis_corr_results);
  ITM_Port32(31) = 12;	// 12: cmsis convolution
  arm_conv_f32(test_array, (uint32_t)array_len, asm_output, (uint32_t)array_len, cmsis_conv_results);
  ITM_Port32(31) = 13;

  /* USER CODE END 2 */

  /* Infinite loop */
  while (1)
  {
	  __asm__ ("nop");
  }
}

void SystemClock_Config(void)
{
  RCC_OscInitTypeDef RCC_OscInitStruct = {0};
  RCC_ClkInitTypeDef RCC_ClkInitStruct = {0};

  /** Configure the main internal regulator output voltage
  */
  if (HAL_PWREx_ControlVoltageScaling(PWR_REGULATOR_VOLTAGE_SCALE1_BOOST) != HAL_OK)
  {
    Error_Handler();
  }
  /** Initializes the RCC Oscillators according to the specified parameters
  * in the RCC_OscInitTypeDef structure.
  */
  RCC_OscInitStruct.OscillatorType = RCC_OSCILLATORTYPE_MSI;
  RCC_OscInitStruct.MSIState = RCC_MSI_ON;
  RCC_OscInitStruct.MSICalibrationValue = 0;
  RCC_OscInitStruct.MSIClockRange = RCC_MSIRANGE_6;
  RCC_OscInitStruct.PLL.PLLState = RCC_PLL_ON;
  RCC_OscInitStruct.PLL.PLLSource = RCC_PLLSOURCE_MSI;
  RCC_OscInitStruct.PLL.PLLM = 1;
  RCC_OscInitStruct.PLL.PLLN = 60;
  RCC_OscInitStruct.PLL.PLLP = RCC_PLLP_DIV2;
  RCC_OscInitStruct.PLL.PLLQ = RCC_PLLQ_DIV2;
  RCC_OscInitStruct.PLL.PLLR = RCC_PLLR_DIV2;
  if (HAL_RCC_OscConfig(&RCC_OscInitStruct) != HAL_OK)
  {
    Error_Handler();
  }
  /** Initializes the CPU, AHB and APB buses clocks
  */
  RCC_ClkInitStruct.ClockType = RCC_CLOCKTYPE_HCLK|RCC_CLOCKTYPE_SYSCLK
                              |RCC_CLOCKTYPE_PCLK1|RCC_CLOCKTYPE_PCLK2;
  RCC_ClkInitStruct.SYSCLKSource = RCC_SYSCLKSOURCE_PLLCLK;
  RCC_ClkInitStruct.AHBCLKDivider = RCC_SYSCLK_DIV1;
  RCC_ClkInitStruct.APB1CLKDivider = RCC_HCLK_DIV1;
  RCC_ClkInitStruct.APB2CLKDivider = RCC_HCLK_DIV1;

  if (HAL_RCC_ClockConfig(&RCC_ClkInitStruct, FLASH_LATENCY_5) != HAL_OK)
  {
    Error_Handler();
  }
}

static void MX_GPIO_Init(void)
{

  /* GPIO Ports Clock Enable */
  __HAL_RCC_GPIOA_CLK_ENABLE();
  __HAL_RCC_GPIOB_CLK_ENABLE();

}

void Error_Handler(void)
{
  __disable_irq();
  while (1)
  {
  }
}
